## conf/local.conf
```bitbake
# SuperGit Local Configuration
# A key-value file for the local configurations for SuperGit

# The path to the actual git binary on the local system
GIT_PATH="/usr/local/Cellar/git/2.7.2/bin/git"

# DevRoot
DEV_ROOT="$HOME/PilotFish/DevRoot"
DEV_MAIN="$DEV_ROOT/Main"
PROJECT="$DEV_ROOT/.project"
TEMPLATE="$DEV_ROOT/.template"
LOGS="$DEV_ROOT/.logs"

# The urls for the main and backup remote repos
MAIN_REMOTE="https://cmiller_pilotfish@bitbucket.org/pilotfishtech/pilotfish.git"

# Main remote name
MAIN_REMOTE_NAME="origin"
```
